#include "infrared.h"

#define		RI_TXD(x)		HAL_GPIO_WritePin(GPIOF, GPIO_PIN_11, (GPIO_PinState)(x));

/**************************************************************************
函数功能：红外-初始化
入口参数：无
返回  值：无
**************************************************************************/
void Infrared_Init(void)
{
	RI_TXD(1);
}


/**************************************************************************
函数功能：红外-开始
入口参数：无
返回  值：无
**************************************************************************/
void Infrared_Start(void)
{
	RI_TXD(0);
	My_Delayms(9);
	RI_TXD(1);
	My_Delayus(4500);
}



/**************************************************************************
函数功能：红外-结束
入口参数：无
返回  值：无
**************************************************************************/
void Infrared_Stop(void)
{
	RI_TXD(0);						//结束
	My_Delayus(560);				//延时0.56ms
	RI_TXD(1);						//关闭红外发射

}



/**************************************************************************
函数功能：红外-发射1bit
入口参数：byte:一字节数据
返回  值：无
**************************************************************************/
void Infrared_SendBit(uint8_t bit)
{
  // 560μs 低电平 (所有位的起始脉冲)
	RI_TXD(0);
	My_Delayus(560);

	// 高电平时间取决于位值
	RI_TXD(1);
	if(bit) {
		My_Delayus(1690);  // 逻辑1: 1690μs (1.69ms) 空间
	} else {
		My_Delayus(560);   // 逻辑0: 560μs 空间
	}
}


/**************************************************************************
函数功能：红外-发射一字节
入口参数：byte:一字节数据
返回  值：无
**************************************************************************/
void Infrared_SendByte(uint8_t byte)
{
    // 逐位发送 (LSB first)
    for(uint8_t i = 0;i < 8;i++)
    {
        uint8_t bit = (byte >> i) & 0x01;  // 提取第i位
        Infrared_SendBit(bit);
    }
}


/**************************************************************************
函数功能：红外-发射数组
入口参数：pData:数组 len：数据长度
返回  值：无
**************************************************************************/
void Infrared_SendpData(uint8_t *pData, uint32_t len)
{
	Infrared_Start();

	for(uint32_t i=0;i < len;i++)
	{
		Infrared_SendByte(pData[i]);
	}

	Infrared_Stop();
}




